## Documentation/devicetree/bindings/eeprom/eeprom.txt
```
= EEPROM Data Device Tree Bindings =

This binding is intended to represent the location of hardware
configuration data stored in EEPROMs.

On a significant proportion of boards, the manufacturer has stored
some data on an EEPROM-like device, for the OS to be able to retrieve
these information and act upon it. Obviously, the OS has to know
about where to retrieve these data from, and where they are stored on
the storage device.

This document is here to document this.

= Data providers =
Contains bindings specific to provider drivers and data cells as children
to this node.

= Data cells =
These are the child nodes of the provider which contain data cell
information like offset and size in eeprom provider.

Required properties:
reg:	specifies the offset in byte within that storage device, and the length
	in bytes of the data we care about.
	There could be more then one offset-length pairs in this property.

Optional properties:
As required by specific data parsers/interpreters.

For example:

	/* Provider */
	qfprom: qfprom@00700000 {
		compatible 	= "qcom,qfprom";
		reg		= <0x00700000 0x8000>;
		...

		/* Data cells */
		tsens_calibration: calib@4404 {
			reg = <0x4404 0x10>;
		};

		serial_number: sn {
			reg = <0x104 0x4>, <0x204 0x4>, <0x30c 0x4>;

		};
		...
	};

= Data consumers =
Are device nodes which consume eeprom data cells.

For example:

	tsens {
		...
		calibration = <&tsens_calibration>;
	};
```

## Documentation/devicetree/bindings/i2c/i2c-qcom-geni.txt
```
Qualcomm Technologies Inc. GENI Serial Engine based I2C Controller

Required properties:
 - compatible: Should be:
   * "qcom,i2c-geni.
 - reg: Should contain QUP register address and length.
 - interrupts: Should contain I2C interrupt.
 - clock-names: Should contain "se-clk".
 - clocks: Serial engine core clock needed by the device.
 - pinctrl-names/pinctrl-0/1: The GPIOs assigned to this core. The names
   should be "active" and "sleep" for the pin confuguration when core is active
   or when entering sleep state.
 - #address-cells: Should be <1> Address cells for i2c device address
 - #size-cells: Should be <0> as i2c addresses have no size component

Optional property:
 - clock-frequency : Desired I2C bus clock frequency in Hz.
   When missing default to 400000Hz.

Child nodes should conform to i2c bus binding.

Example:

i2c0: i2c@a94000 {
	compatible = "qcom,i2c-geni";
	reg = <0xa94000 0x4000>;
	interrupts = <GIC_SPI 358 0>;
	clock-names = "se-clk";
	clocks = <&clock_gcc GCC_QUPV3_WRAP0_S5_CLK>;
	pinctrl-names = "default", "sleep";
	pinctrl-0 = <&qup_1_i2c_5_active>;
	pinctrl-1 = <&qup_1_i2c_5_sleep>;
	#address-cells = <1>;
	#size-cells = <0>;
};
```

## Documentation/devicetree/bindings/power/power_domain.txt
```
* Generic PM domains

System on chip designs are often divided into multiple PM domains that can be
used for power gating of selected IP blocks for power saving by reduced leakage
current.

This device tree binding can be used to bind PM domain consumer devices with
their PM domains provided by PM domain providers. A PM domain provider can be
represented by any node in the device tree and can provide one or more PM
domains. A consumer node can refer to the provider by a phandle and a set of
phandle arguments (so called PM domain specifiers) of length specified by the
#power-domain-cells property in the PM domain provider node.

==PM domain providers==

Required properties:
 - #power-domain-cells : Number of cells in a PM domain specifier;
   Typically 0 for nodes representing a single PM domain and 1 for nodes
   providing multiple PM domains (e.g. power controllers), but can be any value
   as specified by device tree binding documentation of particular provider.

Optional properties:
 - power-domains : A phandle and PM domain specifier as defined by bindings of
                   the power controller specified by phandle.
   Some power domains might be powered from another power domain (or have
   other hardware specific dependencies). For representing such dependency
   a standard PM domain consumer binding is used. When provided, all domains
   created by the given provider should be subdomains of the domain
   specified by this binding. More details about power domain specifier are
   available in the next section.

- domain-idle-states : A phandle of an idle-state that shall be soaked into a
                generic domain power state. The idle state definitions are
                compatible with domain-idle-state specified in [1].
  The domain-idle-state property reflects the idle state of this PM domain and
  not the idle states of the devices or sub-domains in the PM domain. Devices
  and sub-domains have their own idle-states independent of the parent
  domain's idle states. In the absence of this property, the domain would be
  considered as capable of being powered-on or powered-off.

- domain-performance-states : A phandle of the performance states node, which
		defines all the performance states associated with a power
		domain.
  The domain-performance-states property reflects the performance states of this
  PM domain and not the performance states of the devices or sub-domains in the
  PM domain. Devices and sub-domains have their own performance states, which
  are dependent on the performance state of the PM domain.

* PM domain performance states node

This describes the performance states of a PM domain.

Required properties:
- compatible: Allow performance states to express their compatibility. It should
  be: "domain-performance-state".

- Performance state nodes: This node shall have one or more "Performance State"
  nodes.

* Performance state node

Required properties:
- performance-level: A positive integer value representing the performance level
  associated with a performance state. The integer value '1' represents the
  lowest performance level and the highest value represents the highest
  performance level.

Optional properties:
- domain-microvolt: voltage in micro Volts.

  A single regulator's voltage is specified with an array of size one or three.
  Single entry is for target voltage and three entries are for <target min max>
  voltages.

Example:

	power: power-controller@12340000 {
		compatible = "foo,power-controller";
		reg = <0x12340000 0x1000>;
		#power-domain-cells = <1>;
	};

The node above defines a power controller that is a PM domain provider and
expects one cell as its phandle argument.

Example 2:

	parent: power-controller@12340000 {
		compatible = "foo,power-controller";
		reg = <0x12340000 0x1000>;
		#power-domain-cells = <1>;
	};

	child: power-controller@12341000 {
		compatible = "foo,power-controller";
		reg = <0x12341000 0x1000>;
		power-domains = <&parent 0>;
		#power-domain-cells = <1>;
	};

The nodes above define two power controllers: 'parent' and 'child'.
Domains created by the 'child' power controller are subdomains of '0' power
domain provided by the 'parent' power controller.

Example 3:
	parent: power-controller@12340000 {
		compatible = "foo,power-controller";
		reg = <0x12340000 0x1000>;
		#power-domain-cells = <0>;
		domain-idle-states = <&DOMAIN_RET>, <&DOMAIN_PWR_DN>;
	};

	child: power-controller@12341000 {
		compatible = "foo,power-controller";
		reg = <0x12341000 0x1000>;
		power-domains = <&parent 0>;
		#power-domain-cells = <0>;
		domain-idle-states = <&DOMAIN_PWR_DN>;
	};

	DOMAIN_RET: state@0 {
		compatible = "domain-idle-state";
		reg = <0x0>;
		entry-latency-us = <1000>;
		exit-latency-us = <2000>;
		min-residency-us = <10000>;
	};

	DOMAIN_PWR_DN: state@1 {
		compatible = "domain-idle-state";
		reg = <0x1>;
		entry-latency-us = <5000>;
		exit-latency-us = <8000>;
		min-residency-us = <7000>;
	};

==PM domain consumers==

Required properties:
 - power-domains : A phandle and PM domain specifier as defined by bindings of
                   the power controller specified by phandle.

Example:

	leaky-device@12350000 {
		compatible = "foo,i-leak-current";
		reg = <0x12350000 0x1000>;
		power-domains = <&power 0>;
	};

The node above defines a typical PM domain consumer device, which is located
inside a PM domain with index 0 of a power controller represented by a node
with the label "power".

Optional properties:
- domain-performance-state: A phandle of a Performance state node.

Example:

	parent: power-controller@12340000 {
		compatible = "foo,power-controller";
		reg = <0x12340000 0x1000>;
		#power-domain-cells = <0>;
		domain-performance-states = <&domain_perf_states>;
	};

	domain_perf_states: performance_states {
		compatible = "domain-performance-state";
		domain_perf_state1: pstate@1 {
			performance-level = <1>;
			domain-microvolt = <970000 975000 985000>;
		};
		domain_perf_state2: pstate@2 {
			performance-level = <2>;
			domain-microvolt = <1000000 1075000 1085000>;
		};
		domain_perf_state3: pstate@3 {
			performance-level = <3>;
			domain-microvolt = <1100000 1175000 1185000>;
		};
	}

	leaky-device@12350000 {
		compatible = "foo,i-leak-current";
		reg = <0x12350000 0x1000>;
		power-domains = <&power 0>;
		domain-performance-state = <&domain_perf_state2>;
	};

[1]. Documentation/devicetree/bindings/power/domain-idle-state.txt
```

## Documentation/devicetree/bindings/power/qcom,rpmpd.txt
```
Qualcomm RPM Powerdomains

* For RPM powerdomains, we communicate a performance state to RPM
which then translates it into a corresponding voltage on a rail

Required Properties:
 - compatible: Should be one of the following
	* qcom,rpmpd-msm8996: RPM Powerdomain for the msm8996 family of SoC
 - power-domain-cells: number of cells in power domain specifier
	must be 1.
 - domain-performance-state: One or more nodes describing the performance-states
	supported by the powerdomain.
	For domain-performance-state bindings refer to
	Documentation/devicetree/bindings/power/power_domain.txt
```

## Documentation/devicetree/bindings/serial/qcom,geni-uart.txt
```
Qualcomm Technologies Inc. GENI Serial Engine based UART Controller

The Generic Interface (GENI) Serial Engine based UART controller supports
console use-cases and is supported only by GENI based Qualcomm Universal
Peripheral (QUP) cores.

Required properties:
- compatible: should contain "qcom,geni-debug-uart".
- reg: Should contain UART register location and length.
- reg-names: Should contain "se-phys".
- interrupts: Should contain UART core interrupts.
- clock-names: Should contain "se-clk".
- clocks: clocks needed for UART, includes the core clock.
- pinctrl-names/pinctrl-0/1: The GPIOs assigned to this core. The names
  Should be "active" and "sleep" for the pin confuguration when core is active
  or when entering sleep state.

Example:
uart0: qcom,serial@a88000 {
	compatible = "qcom,geni-debug-uart";
	reg = <0xa88000 0x7000>;
	reg-names = "se-phys";
	interrupts = <0 355 0>;
	clock-names = "se-clk";
	clocks = <&clock_gcc GCC_QUPV3_WRAP0_S0_CLK>;
	pinctrl-names = "default", "sleep";
	pinctrl-0 = <&qup_1_uart_3_active>;
	pinctrl-1 = <&qup_1_uart_3_sleep>;
};
```

## Documentation/devicetree/bindings/soc/qcom/qcom,geni-se.txt
```
Qualcomm Technologies, Inc. GENI Serial Engine QUP Wrapper Controller

Generic Interface (GENI) based Qualcomm Universal Peripheral (QUP) wrapper
is a programmable module for supporting a wide range of serial interfaces
like UART, SPI, I2C, I3C, etc. A single QUP module can provide upto 8 Serial
Interfaces, using its internal Serial Engines. The GENI Serial Engine QUP
Wrapper controller is modeled as a node with zero or more child nodes each
representing a serial engine.

Required properties:
- compatible:		Must be "qcom,geni-se-qup".
- reg:			Must contain QUP register address and length.
- clock-names:		Must contain "m-ahb" and "s-ahb".
- clocks:		AHB clocks needed by the device.

Required properties if child node exists:
- #address-cells: Must be 1
- #size-cells: Must be 1
- ranges: Must be present

Properties for children:

A GENI based QUP wrapper controller node can contain 0 or more child nodes
representing serial devices.  These serial devices can be a QCOM UART, I2C
controller, spi controller, or some combination of aforementioned devices.

See the following documentation for child node definitions:
Documentation/devicetree/bindings/i2c/i2c-qcom-geni.txt
Documentation/devicetree/bindings/serial/qcom,geni-uart.txt

Example:
	qup0: qcom,geniqup0@8c0000 {
		compatible = "qcom,geni-se-qup";
		reg = <0x8c0000 0x6000>;
		clock-names = "m-ahb", "s-ahb";
		clocks = <&clock_gcc GCC_QUPV3_WRAP_0_M_AHB_CLK>,
			<&clock_gcc GCC_QUPV3_WRAP_0_S_AHB_CLK>;
		#address-cells = <1>;
		#size-cells = <1>;
		ranges;

		i2c0: i2c@a94000 {
			compatible = "qcom,i2c-geni";
			reg = <0xa94000 0x4000>;
			interrupts = <GIC_SPI 358 0>;
			clock-names = "se-clk";
			clocks = <&clock_gcc GCC_QUPV3_WRAP0_S5_CLK>;
			pinctrl-names = "default", "sleep";
			pinctrl-0 = <&qup_1_i2c_5_active>;
			pinctrl-1 = <&qup_1_i2c_5_sleep>;
			#address-cells = <1>;
			#size-cells = <0>;
		};

		uart0: qcom,serial@a88000 {
			compatible = "qcom,geni-debug-uart";
			reg = <0xa88000 0x7000>;
			reg-names = "se-phys";
			interrupts = <0 355 0>;
			clock-names = "se-clk";
			clocks = <&clock_gcc GCC_QUPV3_WRAP0_S0_CLK>;
			pinctrl-names = "default", "sleep";
			pinctrl-0 = <&qup_1_uart_3_active>;
			pinctrl-1 = <&qup_1_uart_3_sleep>;
		};
	}
```

## drivers/eeprom/Kconfig
```kconfig
menuconfig EEPROM
	tristate "EEPROM Support"
	select REGMAP
	help
	  Support for EEPROM alike devices.

	  This framework is designed to provide a generic interface to EEPROM
	  from both the Linux Kernel and the userspace.

	  If unsure, say no.

if EEPROM

config QCOM_QFPROM
	tristate "QCOM QFPROM Support"
	depends on ARCH_QCOM
	select REGMAP_MMIO
	help
	  Say y here to enable QFPROM support. The QFPROM provides access
	  functions for QFPROM data to rest of the drivers via eeprom interface.

	  This driver can also be built as a module. If so, the module
	  will be called eeprom-qfprom.

endif
```
